## conf/distro/hawkeye.conf
```bitbake
############################################################################
##
## Copyright (C) 2021 Hawkeye Recognition B.V.
## Contact: info@hwky.ai
##
############################################################################

require conf/distro/poky.conf
require hawkeye-base.conf

DISTRO = "hawkeye"
DISTRO_NAME = "HawkeyeOS for Embedded Linux"
# The distro version doesn't include DATE to avoid basehash changes in do_image_mender
DISTRO_VERSION = "${DISTRO_VERSION_BASE}+snapshot"

# Set Initialization Manager
# https://www.yoctoproject.org/docs/current/mega-manual/mega-manual.html#selecting-an-initialization-manager
DISTRO_FEATURES_append = " systemd virtualization"
DISTRO_FEATURES_BACKFILL_CONSIDERED = "sysvinit"
VIRTUAL-RUNTIME_init_manager = "systemd"
VIRTUAL-RUNTIME_initscripts = ""

EXTRA_IMAGE_FEATURES += "ssh-server-openssh"

# Mender
INHERIT += "mender-full distro_layer_buildinfo"
INHERIT_append_tegra = " tegra-mender-setup mender-workarounds"
DISTRO_LAYER = "meta-hawkeye"
MENDER_SERVER_URL ?= "https://mender.hwky.ai"

BUILDNAME ?= "${@d.getVar('DISTRO_VERSION').replace('+snapshot','')}${DISTRO_LAYER_BUILDTAG}"
BUILDNAME[vardepvalue] = "${DISTRO_VERSION}"

MENDER_ARTIFACT_NAME ?= "${IMAGE_BASENAME}_${BUILDNAME}"

IMAGE_FSTYPES_tegra = "tegraflash mender dataimg"
IMAGE_FSTYPES_pn-tegra-minimal-initramfs_tegra = "${INITRAMFS_FSTYPES}"
IMAGE_FEATURES_append = " read-only-rootfs"
IMGCLASSES_append = " rootfs-postcommands-overrides"

# Reserved space for tegraflash partitions, not including APP and DATA
TEGRA_FLASH_PARTITIONS_MB ?= "950"

IMAGE_OVERHEAD_FACTOR = "1.1"
# Make more room for the data partition, so we can use it to hold
# docker container filesystems.
MENDER_DATA_PART_SIZE_MB_DEFAULT_tegra = "10240"

MENDER_STORAGE_DEVICE_BASE ?= "/dev/mmcblk0p"
MENDER_STORAGE_TOTAL_SIZE_MB ?= "${@tegra_mender_calc_total_size(d) - int(d.getVar('TEGRA_FLASH_PARTITIONS_MB'))}"

# Mender machines need to run checks after an update
SYSTEMD_DEFAULT_TARGET = "finished-booting.target"

IMAGE_INSTALL_append_tegra = " tegra-eeprom-tool i2c-tools tegra-bup-payload"

INHERIT += "uninative"

INHERIT += "reproducible_build"

BB_SIGNATURE_HANDLER ?= "OEEquivHash"
BB_HASHSERVE ??= "auto"
```

## conf/layer.conf
```bitbake
BBPATH .= ":${LAYERDIR}"

BBFILES += "${LAYERDIR}/recipes-*/*/*.bb \
            ${LAYERDIR}/recipes-*/*/*.bbappend"

BBFILE_COLLECTIONS += "hawkeye"
BBFILE_PATTERN_hawkeye = "^${LAYERDIR}/"
BBFILE_PRIORITY_hawkeye = "100"
LAYERSERIES_COMPAT_hawkeye = "dunfell"
```
